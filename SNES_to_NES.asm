.NOLIST
.INCLUDE "1200def.inc"
.LIST

.DEVICE AT90S1200

.DEF GEN_COUNT = R16	;USED FOR FULLDELAY_232, HLAFDELAY_232
.DEF DREG = R17	;USED TO STORE RECEIVED DATA
.DEF SNES_HIGH = R18
.DEF SNES_LOW = R19
.DEF NES = R20
.DEF MASK = R21
.DEF READ_COUNT = R22
.DEF GEN_COUNT2 = R23
.DEF NES_SHIFT = R24
.DEF NES_TEMP = R25
.EQU fq = 4000000	;XTal frequency definition

; PORT USAGE:
; RXD		PORT D BIT 5	INPUT
; TXD		PORT D BIT 4	OUTPUT
; NES_CLK	PORT D BIT 2	INPUT INTERRUPT
; NES_DATA	PORT D BIT 0	OUTPUT
;SNES_LATCH PORT B BIT 4	OUTPUT
; SNES_CLK	PORT B BIT 3	OUTPUT
; SNES_DATA PORT B BIT 2	INPUT
; ANALOG	PORT B BIT 1	INPUT ALWAYS VCC/2 	THIS IS DONE TO USE PORT B 0 AS AN INTERRUPT SOURCE
; NES LATCH PORT B BIT 0	INPUT INTERRUPT

.CSEG
.ORG $0000
	RJMP	INIT	;RESET VECTOR
	RJMP NES_OUT	;INT0 VECTOR
	RETI	;TIMER/COUNTER OVERFLOW VECTOR
	RJMP NES_LATCH	;ANALOG COMPARATOR VECTOR


INIT:
	LDI DREG, 0b00010001
	OUT DDRD, DREG	;CONFIGURE PORT D
	LDI DREG, 0b00011000
	OUT DDRB, DREG	;CONFIGURE PORT B
	LDI DREG, 0b01000000
	OUT GIMSK, DREG	;ENABLE INT0
	IN DREG, MCUCR
	ORI DREG, 0b00000011
	OUT MCUCR, DREG	;CONFIGURE INT0 FOR RISING EDGE
	LDI DREG, 0b00001011
	OUT ACSR, DREG	;POWER ON THE ANALOG COMPARATOR AND ENABLE THE INTERRUPT
	LDI NES_SHIFT, 0xFF	;CLEAR ALL BUTTONS
	SEI	;ENABLE INTERRUPTS
	RJMP MAIN

NES_OUT:
	CBI PORTD, 0
	SBRC NES_SHIFT, 0
	SBI PORTD, 0	;COPY BIT 0 FROM NES SHIFT TO NES DATA
	LSR NES_SHIFT	;SHIFT NES_SHIFT RIGHT
	RETI

NES_LATCH:
	CBI PORTD, 0
	SBRC NES, 0
	SBI PORTD, 0	;COPY BIT 0 FROM NES TO NES DATA LINE
	MOV NES_SHIFT, NES	;COPY NEW DATA TO SHIFT REGISTER
	LSR NES_SHIFT	;PREPARE NEXT BIT
	RETI

SNES_READ:
	CLR SNES_HIGH
	CLR SNES_LOW
	SBI PORTB, 4	;SET LATCH HIGH
	SBI PORTB, 3	;SET CLK HIGH
	RCALL SNES_DELAY
	CBI PORTB, 4	;CLEAR LATCH
	CBI PORTB, 3	;CLEAR CLK
	RCALL SNES_DELAY
	SBIC PINB, 2	;CHECK SNES DATA
	SBR SNES_LOW, 0B00000001	;SET BIT 0
	
	SBI PORTB, 3	;SET CLK HIGH
	RCALL SNES_DELAY
	CBI PORTB, 3	;CLEAR CLK
	RCALL SNES_DELAY
	SBIC PINB, 2	;CHECK SNES DATA
	SBR SNES_LOW, 0B00000010	;SET BIT 1

	SBI PORTB, 3	;SET CLK HIGH
	RCALL SNES_DELAY
	CBI PORTB, 3	;CLEAR CLK
	RCALL SNES_DELAY
	SBIC PINB, 2	;CHECK SNES DATA
	SBR SNES_LOW, 0B00000100	;SET BIT 2

	SBI PORTB, 3	;SET CLK HIGH
	RCALL SNES_DELAY
	CBI PORTB, 3	;CLEAR CLK
	RCALL SNES_DELAY
	SBIC PINB, 2	;CHECK SNES DATA
	SBR SNES_LOW, 0B00001000	;SET BIT 3

	SBI PORTB, 3	;SET CLK HIGH
	RCALL SNES_DELAY
	CBI PORTB, 3	;CLEAR CLK
	RCALL SNES_DELAY
	SBIC PINB, 2	;CHECK SNES DATA
	SBR SNES_LOW, 0B00010000	;SET BIT 4

	SBI PORTB, 3	;SET CLK HIGH
	RCALL SNES_DELAY
	CBI PORTB, 3	;CLEAR CLK
	RCALL SNES_DELAY
	SBIC PINB, 2	;CHECK SNES DATA
	SBR SNES_LOW, 0B00100000	;SET BIT 5

	SBI PORTB, 3	;SET CLK HIGH
	RCALL SNES_DELAY
	CBI PORTB, 3	;CLEAR CLK
	RCALL SNES_DELAY
	SBIC PINB, 2	;CHECK SNES DATA
	SBR SNES_LOW, 0B01000000	;SET BIT 6

	SBI PORTB, 3	;SET CLK HIGH
	RCALL SNES_DELAY
	CBI PORTB, 3	;CLEAR CLK
	RCALL SNES_DELAY
	SBIC PINB, 2	;CHECK SNES DATA
	SBR SNES_LOW, 0B10000000	;SET BIT 7

	SBI PORTB, 3	;SET CLK HIGH
	RCALL SNES_DELAY
	CBI PORTB, 3	;CLEAR CLK
	RCALL SNES_DELAY
	SBIC PINB, 2	;CHECK SNES DATA
	SBR SNES_HIGH, 0B00000001	;SET BIT 0

	SBI PORTB, 3	;SET CLK HIGH
	RCALL SNES_DELAY
	CBI PORTB, 3	;CLEAR CLK
	RCALL SNES_DELAY
	SBIC PINB, 2	;CHECK SNES DATA
	SBR SNES_HIGH, 0B00000010	;SET BIT 1

	SBI PORTB, 3	;SET CLK HIGH
	RCALL SNES_DELAY
	CBI PORTB, 3	;CLEAR CLK
	RCALL SNES_DELAY
	SBIC PINB, 2	;CHECK SNES DATA
	SBR SNES_HIGH, 0B00000100	;SET BIT 2

	SBI PORTB, 3	;SET CLK HIGH
	RCALL SNES_DELAY
	CBI PORTB, 3	;CLEAR CLK
	RCALL SNES_DELAY
	SBIC PINB, 2	;CHECK SNES DATA
	SBR SNES_HIGH, 0B00001000	;SET BIT 3

	SBI PORTB, 3	;SET CLK HIGH
	RCALL SNES_DELAY
	CBI PORTB, 3	;CLEAR CLK
	RCALL SNES_DELAY
	SBIC PINB, 2	;CHECK SNES DATA
	SBR SNES_HIGH, 0B00010000	;SET BIT 4

	SBI PORTB, 3	;SET CLK HIGH
	RCALL SNES_DELAY
	CBI PORTB, 3	;CLEAR CLK
	RCALL SNES_DELAY
	SBIC PINB, 2	;CHECK SNES DATA
	SBR SNES_HIGH, 0B00100000	;SET BIT 5

	SBI PORTB, 3	;SET CLK HIGH
	RCALL SNES_DELAY
	CBI PORTB, 3	;CLEAR CLK
	RCALL SNES_DELAY
	SBIC PINB, 2	;CHECK SNES DATA
	SBR SNES_HIGH, 0B01000000	;SET BIT 6

	SBI PORTB, 3	;SET CLK HIGH
	RCALL SNES_DELAY
	CBI PORTB, 3	;CLEAR CLK
	RCALL SNES_DELAY
	SBIC PINB, 2	;CHECK SNES DATA
	SBR SNES_HIGH, 0B10000000	;SET BIT 7
	RET

MAIN:
	RCALL SNES_READ
	MOV NES_TEMP, SNES_LOW	;MOST BITS ARE THE SAME IN NES AND SNES
	ANDI NES_TEMP, 0B11111100	;BUT THE LOW 2 BITS ARE DIFFERENT
	SBRC SNES_HIGH, 0	;CHECK BIT 0 IN SNES HIGH
	ORI NES_TEMP, 0B00000001	;IF BIT 0 IN SNES IS SET THEN SET BIT 0 IN NES
	SBRC SNES_LOW, 0
	ORI NES_TEMP, 0B00000010	;IF BIT 0 IN SNES LOW IS SET THEN SET BIT 1 IN NES
	EOR NES_TEMP, MASK	;MODIFY A AND B
	SBRS SNES_HIGH, 3	;CHECK THE RIGHT BUTTON
	RCALL KONAMI	;IF RIGHT BUTTON IS PRESSED CALL KONAMI MACRO
	SBRS SNES_HIGH, 2	;CHECK THE LEFT BUTTON
	ANDI NES_TEMP, 0b11111110	;IF LEFT BUTTON IS PRESSED THEN PRESS BUTTON A IN NES
	INC READ_COUNT
	;CPI READ_COUNT, 0x80
	;BRNE M_NO_RESET
	;CLR READ_COUNT
;M_NO_RESET:
	CLR MASK
	SBRC SNES_HIGH, 1	;CHECK X BUTTON IN SNES
	RJMP NO_X
	ORI MASK, 0B00000001	;INVERT BUTTON A IN NES
NO_X:
	SBRC SNES_LOW, 1	;CHECK Y BUTTON IN SNES
	RJMP MAIN_TOGGLE
	ORI MASK, 0B00000010	;INVERT BUTTIN B IN NES
MAIN_TOGGLE:
	SBRC READ_COUNT, 7
	CLR MASK	;IF BIT 7 IN READ COUNT IS SET THEN CLEAR MASK
	MOV NES, NES_TEMP	;UPDATE NES REGISTER
	RJMP MAIN

KONAMI:
	LDI NES, 0b11101111	;PRESS UP
	RCALL LONG_DELAY
	LDI NES, 0xFF	;CLEAR ALL BUTTONS
	RCALL LONG_DELAY
	LDI NES, 0b11101111	;PRESS UP
	RCALL LONG_DELAY
	LDI NES, 0xFF	;CLEAR ALL BUTTONS
	RCALL LONG_DELAY
	LDI NES, 0b11011111	;PRESS DOWN
	RCALL LONG_DELAY
	LDI NES, 0xFF	;CLEAR ALL BUTTONS
	RCALL LONG_DELAY
	LDI NES, 0b11011111	;PRESS DOWN
	RCALL LONG_DELAY
	LDI NES, 0xFF	;CLEAR ALL BUTTONS
	RCALL LONG_DELAY
	LDI NES, 0b10111111	;PRESS LEFT
	RCALL LONG_DELAY
	LDI NES, 0xFF	;CLEAR ALL BUTTONS
	RCALL LONG_DELAY
	LDI NES, 0b01111111	;PRESS RIGHT
	RCALL LONG_DELAY
	LDI NES, 0xFF	;CLEAR ALL BUTTONS
	RCALL LONG_DELAY
	LDI NES, 0b10111111	;PRESS LEFT
	RCALL LONG_DELAY
	LDI NES, 0xFF	;CLEAR ALL BUTTONS
	RCALL LONG_DELAY
	LDI NES, 0b01111111	;PRESS RIGHT
	RCALL LONG_DELAY
	LDI NES, 0xFF	;CLEAR ALL BUTTONS
	RCALL LONG_DELAY
	LDI NES, 0b11111101	;PRESS B
	RCALL LONG_DELAY
	LDI NES, 0xFF	;CLEAR ALL BUTTONS
	RCALL LONG_DELAY
	LDI NES, 0b11111110	;PRESS A
	RCALL LONG_DELAY
	LDI NES, 0xFF	;CLEAR ALL BUTTONS
	RET


RECEIVE_232:
	CLR DREG
WAIT_232:
	SBIC	PIND, 5
	RJMP	WAIT_232
	RCALL	HALFDELAY_232
	RCALL	FULLDELAY_232
	SBIC	PIND, 5	;CHECK BIT 0
	SBR	DREG, 0B00000001
	RCALL	FULLDELAY_232
	SBIC	PIND, 5	;CHECK BIT 1
	SBR	DREG, 0B00000010
	RCALL	FULLDELAY_232
	SBIC	PIND, 5	;CHECK BIT 2
	SBR	DREG, 0B00000100
	RCALL	FULLDELAY_232
	SBIC	PIND, 5	;CHECK BIT 3
	SBR	DREG, 0B00001000
	RCALL	FULLDELAY_232
	SBIC	PIND, 5	;CHECK BIT 4
	SBR	DREG, 0B00010000
	RCALL	FULLDELAY_232
	SBIC	PIND, 5	;CHECK BIT 5
	SBR	DREG, 0B00100000
	RCALL	FULLDELAY_232
	SBIC	PIND, 5	;CHECK BIT 6
	SBR	DREG, 0B01000000
	RCALL	FULLDELAY_232
	SBIC	PIND, 5	;CHECK BIT 7
	SBR	DREG, 0B10000000
	RCALL	HALFDELAY_232
	RET

SEND_232:
	CBI  PORTD, 4	;SEND STARTING BIT
	RCALL FULLDELAY_232
	SBRC DREG, 0	;TEST BIT 0
	SBI  PORTD, 4	;IF SET IN REGISTER SET TX LINE
	SBRS DREG, 0	;TEST BIT 0
	CBI  PORTD, 4	;IF CLEAR IN REGISTER CLEAR TX LINE
	RCALL TXDELAY_232
	SBRC DREG, 1
	SBI  PORTD, 4
	SBRS DREG, 1
	CBI  PORTD, 4
	RCALL TXDELAY_232
	SBRC DREG, 2
	SBI  PORTD, 4
	SBRS DREG, 2
	CBI  PORTD, 4
	RCALL TXDELAY_232
	SBRC DREG, 3
	SBI  PORTD, 4
	SBRS DREG, 3
	CBI  PORTD, 4
	RCALL TXDELAY_232
	SBRC DREG, 4
	SBI  PORTD, 4
	SBRS DREG, 4
	CBI  PORTD, 4
	RCALL TXDELAY_232
	SBRC DREG, 5
	SBI  PORTD, 4
	SBRS DREG, 5
	CBI  PORTD, 4
	RCALL TXDELAY_232
	SBRC DREG, 6
	SBI  PORTD, 4
	SBRS DREG, 6
	CBI  PORTD, 4
	RCALL TXDELAY_232
	SBRC DREG, 7
	SBI  PORTD, 4
	SBRS DREG, 7
	CBI  PORTD, 4
	RCALL TXDELAY_232
	SBI  PORTD, 4	;SEND STOP BIT
	RCALL FULLDELAY_232
	RET

HALFDELAY_232:	;DESIGNED FOR 4MHz CLOCK AND 9600 BAUD
	LDI GEN_COUNT, 0x33
HALFDELAY_2232:
	NOP
	DEC GEN_COUNT
	BRNE HALFDELAY_2232
	RET

FULLDELAY_232:	;DESIGNED FOR 4MHz CLOCK AND 9600 BAUD
	LDI GEN_COUNT, 0x66
FULLDELAY_2232:
	NOP
	DEC GEN_COUNT
	BRNE FULLDELAY_2232
	RET

TXDELAY_232:	;DESIGNED FOR 4MHz CLOCK AND 9600 BAUD
	LDI GEN_COUNT, 0x65
TXDELAY_2232:
	NOP
	DEC GEN_COUNT
	BRNE TXDELAY_2232
	RET

SNES_DELAY:
	LDI GEN_COUNT, 0x14
SNES_DELAY2:
	DEC GEN_COUNT
	BRNE SNES_DELAY2
	RET

LONG_DELAY:
	LDI GEN_COUNT, 0xFF
	LDI GEN_COUNT2, 0xF0
LONGD2:
	DEC GEN_COUNT
	BRNE LONGD2
	LDI GEN_COUNT, 0xFF
	DEC GEN_COUNT2
	BRNE LONGD2
	RET

.ESEG
	.DB "THIS PROGRAM ADAPTS A SNES JOYPAD TO A NES CONSOLE. *STEVE*"

